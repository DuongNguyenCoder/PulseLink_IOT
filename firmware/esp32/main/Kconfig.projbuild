## firmware/esp32/main/Kconfig.projbuild
```kconfig
menu "PulseLink firmware"

config PULSELINK_FIRMWARE_VERSION
    string "Firmware version"
    default "0.1.0-wifi-smoke"
    help
        Version printed at boot. Do not put secrets here.

config PULSELINK_BUILD_PROFILE
    string "Firmware build profile"
    default "default"
    help
        Non-secret label embedded in the image to distinguish controlled
        build profiles. Use the profile scripts to select default or staging.

config PULSELINK_WIFI_SSID
    string "Wi-Fi SSID"
    default ""
    help
        Configure locally with menuconfig. This value is not logged.

config PULSELINK_WIFI_PASSWORD
    string "Wi-Fi password"
    default ""
    help
        Configure locally with menuconfig. Never commit sdkconfig or log this value.

config PULSELINK_BACKEND_URL
    string "Backend health URL"
    default ""
    help
        Local HTTP smoke-test URL, for example http://192.168.1.171:3000/health/live.
        Do not put credentials or tokens in this URL. Leave empty to disable the test.

config PULSELINK_REDEMPTION_BASE_URL
    string "Provisioning redemption HTTPS base URL"
    default ""
    help
        HTTPS origin for the existing /v1/devices/.../redeem endpoint.
        Do not include credentials or tokens. Leave empty until the protected
        operational-credential storage policy is approved.

config PULSELINK_EVENT_ENDPOINT_URL
    string "Device event HTTPS endpoint"
    default ""
    help
        Full HTTPS endpoint, for example https://api.example.com/v1/device-events.
        Never include the Authorization header or device token in this URL.

config PULSELINK_DEVICE_TOKEN
    string "Operational device token"
    default ""
    help
        Configure per-device in local sdkconfig or secure provisioning tooling.
        Never commit this value or print it in logs.

config PULSELINK_BUTTON_GPIO
    int "Event button GPIO"
    range -1 48
    default 4
    help
        MVP Event button mapping. Verify carrier-board wiring before hardware operation.

config PULSELINK_STATUS_LED_GPIO
    int "Status LED GPIO (-1 until the carrier board is verified)"
    range -1 48
    default -1
    help
        Do not select a GPIO until the actual carrier-board schematic is confirmed.

config PULSELINK_COMMISSIONING_ENABLED
    bool "Enable button-gated SoftAP commissioning"
    default y
    select MBEDTLS_HKDF_C
    help
        Enables the physical-confirmation gate, SoftAP transport and commissioning
        lifecycle. The MVP baseline uses the separately configurable NVS identity
        and operational-credential providers. This does not protect NVS contents
        at rest or verify carrier-board button wiring.

config PULSELINK_COMMISSIONING_BUTTON_GPIO
    int "Commissioning button GPIO"
    range -1 48
    default 5
    help
        The MVP source configuration assigns GPIO5, separate from the GPIO4
        event button. Firmware samples it active-low with the internal pull-up.
        Verify carrier-board wiring and peripheral use before hardware operation.

config PULSELINK_DEVICE_IDENTITY_NVS_PROVIDER
    bool "Enable NVS device identity provider (private key is extractable without flash protection)"
    default y
    help
        Generates a unique P-256 identity on first boot and stores its key in
        the identity NVS namespace. This is an MVP proof-of-possession identity,
        not genuine-hardware attestation: raw flash access can clone the key
        unless a separately approved flash protection policy is enabled. This is
        the approved MVP TOFU baseline, not protected-at-rest storage. Corrupt or
        unreadable existing records fail closed.

config PULSELINK_OPERATIONAL_CREDENTIAL_STORAGE
    bool "Enable operational credential persistence in NVS (not protected at rest by default)"
    default y
    help
        Enables per-device operational token persistence and read-back through
        the NVS storage provider. Without NVS_ENCRYPTION, the token is stored
        in ordinary NVS and is extractable from raw flash. This option does not
        enable NVS encryption or claim protection at rest. The MVP accepts this
        TOFU limitation; deployments needing at-rest protection must use a
        separately approved encryption and recovery policy.

endmenu
```

## firmware/esp32/sdkconfig.defaults
```kconfig
CONFIG_IDF_TARGET="esp32s3"
# The supported ESP32-S3-WROOM-1 N16R8 target has 16 MiB flash. Keep the
# image header consistent for all build profiles.
CONFIG_ESPTOOLPY_FLASHSIZE_16MB=y
CONFIG_PULSELINK_FIRMWARE_VERSION="0.1.0-wifi-smoke"
CONFIG_PULSELINK_BUILD_PROFILE="default"
CONFIG_PULSELINK_WIFI_SSID=""
CONFIG_PULSELINK_WIFI_PASSWORD=""
CONFIG_PULSELINK_BACKEND_URL=""
CONFIG_PULSELINK_EVENT_ENDPOINT_URL=""
CONFIG_PULSELINK_DEVICE_TOKEN=""
CONFIG_PULSELINK_BUTTON_GPIO=4
CONFIG_PULSELINK_STATUS_LED_GPIO=-1
CONFIG_PULSELINK_COMMISSIONING_ENABLED=y
CONFIG_PULSELINK_COMMISSIONING_BUTTON_GPIO=5
CONFIG_PULSELINK_DEVICE_IDENTITY_NVS_PROVIDER=y
CONFIG_PULSELINK_OPERATIONAL_CREDENTIAL_STORAGE=y
CONFIG_COMPILER_OPTIMIZATION_SIZE=y
CONFIG_MBEDTLS_CERTIFICATE_BUNDLE=y
CONFIG_MBEDTLS_CERTIFICATE_BUNDLE_DEFAULT_FULL=y
```
